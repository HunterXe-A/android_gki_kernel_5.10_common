## drivers/misc/bq_ra_reader/Kconfig
```kconfig
# SPDX-License-Identifier: GPL-2.0
config BQ_RA_READER
	tristate "BQ28Z610 RA table reader"
	depends on I2C && I2C_SMBUS && SYSFS
	help
	  Read the NFG1000B/BQ28Z610 RA table through a read-only sysfs node.

config RA_READER
	tristate "Reusable I2C MAC read framework"
	depends on I2C && I2C_SMBUS && SYSFS && MI_HARDWARE_ID
	help
	  An I2C AltManufacturerAccess (MAC) read framework for the bq28z610
	  driver. It also provides read-only sealed and read-write seal nodes;
	  security operations are accepted only after live identification as a
	  type4 gauge.
```
